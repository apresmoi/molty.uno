## firmware/main/Kconfig.projbuild
```kconfig
menu "Molty"

choice MOLTY_BOARD
    prompt "Board"
    default MOLTY_BOARD_WAVESHARE_ESP32_S3_TOUCH_LCD_1_46
    help
        The hardware this firmware drives: exactly one folder under firmware/boards/
        is compiled in. Set it with the board's sdkconfig.board, which the build
        layers over sdkconfig.defaults when you pass -DMOLTY_BOARD=<vendor>/<model>
        (scripts/firmware-build.sh does). Changing it here alone leaves flash and
        PSRAM settings of the old board: the build stops and says so.
        Adding a board: docs/PORTING.md.

config MOLTY_BOARD_WAVESHARE_ESP32_S3_TOUCH_LCD_1_46
    bool "Waveshare ESP32-S3-Touch-LCD-1.46 (412x412 round)"

config MOLTY_BOARD_WAVESHARE_ESP32_S3_TOUCH_LCD_1_28
    bool "Waveshare ESP32-S3-Touch-LCD-1.28 (240x240 round)"

endchoice

config MOLTY_BOARD_DIR
    string
    default "waveshare/esp32-s3-touch-lcd-1.46" if MOLTY_BOARD_WAVESHARE_ESP32_S3_TOUCH_LCD_1_46
    default "waveshare/esp32-s3-touch-lcd-1.28" if MOLTY_BOARD_WAVESHARE_ESP32_S3_TOUCH_LCD_1_28

config MOLTY_DEFAULT_RELAY
    string "Default agent-link relay URL"
    default "wss://molty-relay.alicenet.workers.dev"
    help
        Relay origin the device dials when no relay URL has been saved in NVS
        (the console's "Connect an agent" settings, POST /api/link, can change it).
        wss://host for a deployed relay, or ws://<LAN-IP>:8787 for `wrangler dev`.
        The device appends /v1/device?id=<device_id>. See docs/AGENT-LINK.md.

endmenu
```
